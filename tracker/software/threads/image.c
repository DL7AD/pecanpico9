#include "ch.h"
#include "hal.h"

#include "debug.h"
#include "threads.h"
#include "ov5640.h"
#include "pi2c.h"
#include "ssdv.h"
#include "aprs.h"
#include "radio.h"
#include "base.h"
#include <string.h>
#include "types.h"
#include "sleep.h"
#include "watchdog.h"
#include "flash.h"

const uint8_t noCameraFound[] = {
	0xFF, 0xD8, 0xFF, 0xE0, 0x00, 0x10, 0x4A, 0x46, 0x49, 0x46, 0x00, 0x01, 0x01, 0x01, 0x00, 0x48, 
	0x00, 0x48, 0x00, 0x00, 0xFF, 0xDB, 0x00, 0x43, 0x00, 0x10, 0x0B, 0x0C, 0x0E, 0x0C, 0x0A, 0x10, 
	0x0E, 0x0D, 0x0E, 0x12, 0x11, 0x10, 0x13, 0x18, 0x28, 0x1A, 0x18, 0x16, 0x16, 0x18, 0x31, 0x23, 
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	0xBD, 0xC0, 0x20, 0x00, 0x01, 0xFF, 0xD9
};

static uint8_t gimage_id; // Global image ID (for all image threads)
mutex_t camera_mtx;

void encode_ssdv(const uint8_t *image, uint32_t image_len, module_conf_t* conf, uint8_t image_id, bool redudantTx)
{
	ssdv_t ssdv;
	uint8_t pkt[SSDV_PKT_SIZE];
	uint8_t pkt_base91[BASE91LEN(SSDV_PKT_SIZE-37)];
	const uint8_t *b;
	uint32_t bi = 0;
	uint8_t c = SSDV_OK;
	uint16_t i = 0;

	// Init SSDV (FEC at 2FSK, non FEC at APRS)
	bi = 0;
	ssdv_enc_init(&ssdv, SSDV_TYPE_NORMAL, conf->ssdv_conf.callsign, image_id, conf->ssdv_conf.quality);
	ssdv_enc_set_buffer(&ssdv, pkt);

	// Init transmission packet
	radioMSG_t msg;
	msg.bin_len = 0;
	msg.freq = getFrequency(&conf->frequency);
	msg.power = conf->power;

	//image_id = 0; // FIXME temporary

	ax25_t ax25_handle;
	if(conf->protocol == PROT_APRS_2GFSK || conf->protocol == PROT_APRS_AFSK)
	{
		msg.mod = conf->protocol == PROT_APRS_AFSK ? MOD_AFSK : MOD_2GFSK;
		msg.afsk_conf = &(conf->afsk_conf);
		msg.gfsk_conf = &(conf->gfsk_conf);
		aprs_encode_data_init(&ax25_handle, msg.msg, msg.mod);
	}

	while(true)
	{
		conf->wdg_timeout = chVTGetSystemTimeX() + S2ST(600); // TODO: Implement more sophisticated method

		while((c = ssdv_enc_get_packet(&ssdv)) == SSDV_FEED_ME)
		{
			b = &image[bi];
			uint8_t r = bi < image_len-128 ? 128 : image_len - bi;
			bi += r;

			if(r <= 0)
			{
				TRACE_ERROR("SSDV > Premature end of file");
				if(conf->protocol == PROT_APRS_2GFSK || conf->protocol == PROT_APRS_AFSK) msg.bin_len = aprs_encode_data_finalize(&ax25_handle);
				if(msg.bin_len > 0) transmitOnRadio(&msg, false); // Empty buffer
				if(conf->protocol == PROT_APRS_2GFSK || conf->protocol == PROT_APRS_AFSK)
				{
					aprs_encode_data_init(&ax25_handle, msg.msg, msg.mod);
					msg.bin_len = 0;
				}
				break;
			}
			ssdv_enc_feed(&ssdv, b, r);
		}

		if(c == SSDV_EOI)
		{
			TRACE_INFO("SSDV > ssdv_enc_get_packet said EOI");
			if(conf->protocol == PROT_APRS_2GFSK || conf->protocol == PROT_APRS_AFSK) msg.bin_len = aprs_encode_data_finalize(&ax25_handle);
			if(msg.bin_len > 0) transmitOnRadio(&msg, false); // Empty buffer
			if(conf->protocol == PROT_APRS_2GFSK || conf->protocol == PROT_APRS_AFSK)
			{
				aprs_encode_data_init(&ax25_handle, msg.msg, msg.mod);
				msg.bin_len = 0;
			}
			break;
		} else if(c != SSDV_OK) {
			TRACE_ERROR("SSDV > ssdv_enc_get_packet failed: %i", c);
			if(conf->protocol == PROT_APRS_2GFSK || conf->protocol == PROT_APRS_AFSK) msg.bin_len = aprs_encode_data_finalize(&ax25_handle);
			if(msg.bin_len > 0) transmitOnRadio(&msg, false); // Empty buffer
			if(conf->protocol == PROT_APRS_2GFSK || conf->protocol == PROT_APRS_AFSK)
			{
				aprs_encode_data_init(&ax25_handle, msg.msg, msg.mod);
				msg.bin_len = 0;
			}
			return;
		}

		switch(conf->protocol) {
			case PROT_APRS_2GFSK:
			case PROT_APRS_AFSK:
				// Encode packet
				TRACE_INFO("IMG  > Encode APRS/SSDV packet");
				base91_encode(&pkt[1], pkt_base91, sizeof(pkt)-37); // Sync byte, CRC and FEC of SSDV not transmitted
				msg.bin_len = aprs_encode_data_encodePacket(&ax25_handle, 'I', &conf->aprs_conf, pkt_base91, strlen((char*)pkt_base91));
				if(redudantTx)
					msg.bin_len = aprs_encode_data_encodePacket(&ax25_handle, 'I', &conf->aprs_conf, pkt_base91, strlen((char*)pkt_base91));

				// Transmit
				if(msg.bin_len >= 58000 || conf->packet_spacing) // Transmit if buffer is almost full or if single packet transmission is activated (packet_spacing != 0)
				{
					// Transmit packets
					msg.bin_len = aprs_encode_data_finalize(&ax25_handle);
					transmitOnRadio(&msg, false);

					// Initialize new packet buffer
					aprs_encode_data_init(&ax25_handle, msg.msg, msg.mod);
					msg.bin_len = 0;

					//chThdSleepMilliseconds(8000); // FIXME: Throttle it for my poor TH-D72. Has to be removed later.
				}
				break;

			case PROT_SSDV_2FSK:
				msg.mod = MOD_2FSK;
				msg.fsk_conf = &(conf->fsk_conf);

				// Encode packet
				TRACE_INFO("IMG  > Encode 2FSK/SSDV packet");
				memcpy(&msg.msg[msg.bin_len/8], pkt, sizeof(pkt));
				msg.bin_len += 8*sizeof(pkt);
				if(redudantTx)
				{
					memcpy(&msg.msg[msg.bin_len/8], pkt, sizeof(pkt));
					msg.bin_len += 8*sizeof(pkt);
				}

				// Transmit
				if(msg.bin_len >= 61440 || conf->packet_spacing) { // Transmit if buffer is full or if single packet transmission activation (packet_spacing != 0)
					// Transmit packets
					transmitOnRadio(&msg, false);

					// Initialize new packet buffer
					msg.bin_len = 0;
				}
				break;

			default:
				TRACE_ERROR("IMG  > Unsupported protocol selected for module IMAGE");
		}

		// Packet spacing (delay)
		if(conf->packet_spacing)
			chThdSleepMilliseconds(conf->packet_spacing);

		i++;
	}
}

THD_FUNCTION(imgThread, arg) {
	module_conf_t* conf = (module_conf_t*)arg;
	bool camInitialized = false;

	systime_t time = chVTGetSystemTimeX();
	while(true)
	{
		TRACE_INFO("IMG  > Do module IMAGE cycle");
		conf->wdg_timeout = chVTGetSystemTimeX() + S2ST(600); // TODO: Implement more sophisticated method

		if(!p_sleep(&conf->sleep_conf))
		{
			uint32_t image_len = 0;
			uint8_t *image;

			// Lock camera FIXME: Removed for testing
			TRACE_INFO("IMG  > Lock camera");
			chMtxLock(&camera_mtx);

			uint8_t tries;
			bool status = false;
			bool camera_found = false;

			// Detect camera
			if(camInitialized || OV5640_isAvailable()) { // OV5640 available

				TRACE_INFO("IMG  > OV5640 found");
				camera_found = true;

				if(conf->ssdv_conf.res == RES_MAX) // Attempt maximum resolution (limited by memory)
				{
					conf->ssdv_conf.res = RES_UXGA; // Try maximum resolution

					do {

						// Init camera
						if(!camInitialized) {
							OV5640_init(&conf->ssdv_conf);
							camInitialized = true;
						}

						// Sample data from DCMI through DMA into RAM
						tries = 5; // Try 5 times at maximum
						do { // Try capturing image until capture successful
							lockRadio(); // Lock radio
							status = OV5640_Snapshot2RAM();
							unlockRadio(); // Unlock radio
						} while(!status && --tries);

						conf->ssdv_conf.res--; // Decrement resolution in next attempt (if status==false)

					} while(OV5640_BufferOverflow() && conf->ssdv_conf.res >= RES_QVGA);

					conf->ssdv_conf.res = RES_MAX; // Revert register

				} else { // Static resolution

					// Init camera
					if(!camInitialized) {
						OV5640_init(&conf->ssdv_conf);
						camInitialized = true;
					}

					// Sample data from DCMI through DMA into RAM
					tries = 5; // Try 5 times at maximum
					do { // Try capturing image until capture successful
						status = OV5640_Snapshot2RAM();
					} while(!status && --tries);

				}

				// Switch off camera
				if(!keep_cam_switched_on) {
					OV5640_deinit();
					camInitialized = false;
				}

				// Get image
				image_len = OV5640_getBuffer(&image);
				TRACE_INFO("IMG  > Image size: %d bytes", image_len);

			} else { // Camera error

				camInitialized = false;
				TRACE_ERROR("IMG  > No camera found");

			}

			// Unlock camera FIXME: Removed for testing
			TRACE_INFO("IMG  > Unlock camera");
			chMtxUnlock(&camera_mtx);

			// Encode/Transmit SSDV if image sampled successfully
			if(status) {

				gimage_id++;
				TRACE_INFO("IMG  > Encode/Transmit SSDV ID=%d", gimage_id-1);
				encode_ssdv(image, image_len, conf, gimage_id-1, conf->ssdv_conf.redundantTx);

			} else if(!camera_found) { // No camera found

				gimage_id++;
				TRACE_INFO("IMG  > Encode/Transmit SSDV (no cam found) ID=%d", gimage_id-1);
				encode_ssdv(noCameraFound, sizeof(noCameraFound), conf, gimage_id-1, conf->ssdv_conf.redundantTx);

			}
		}

		time = waitForTrigger(time, &conf->trigger);
	}
}

void start_image_thread(module_conf_t *conf)
{
	if(conf->init_delay) chThdSleepMilliseconds(conf->init_delay);
	TRACE_INFO("IMG  > Startup image thread");
	chsnprintf(conf->name, sizeof(conf->name), "IMG");
	thread_t *th = chThdCreateFromHeap(NULL, THD_WORKING_AREA_SIZE(100*1024), "IMG", NORMALPRIO, imgThread, conf);
	if(!th) {
		// Print startup error, do not start watchdog for this thread
		TRACE_ERROR("IMG  > Could not startup thread (not enough memory available)");
	} else {
		register_thread_at_wdg(conf);
		conf->wdg_timeout = chVTGetSystemTimeX() + S2ST(1);
	}
}

